## examples/chatgpt_demo/factory_nvs/main/Kconfig.projbuild
```kconfig
menu "Example Configuration"

    config ESP_WIFI_SSID
        string "WiFi SSID"
        default "test123"
        help
            SSID (network name) for the example to connect to.
    config ESP_WIFI_PASSWORD
        string "WiFi Password"
        default "nothingistrue"
        help
            WiFi password (WPA or WPA2) for the example to use.
    config OPENAI_API_KEY
        string "OpenAI Key"
        default "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"
        help
            OpenAI api key for the example to use.
    config OPENAI_URL
        string "Base URL"
        default "https://api.openai.com/v1/"
        help
            Base URL for OpenAI API

endmenu
```
